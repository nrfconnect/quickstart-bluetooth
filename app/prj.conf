## CMakeLists.txt
```
# Copyright (c) 2026 Nordic Semiconductor ASA
#
# SPDX-License-Identifier: LicenseRef-Nordic-5-Clause
#
# quickstart-bluetooth application (peripheral_lbs + Memfault over MDS).
# Plain Zephyr application — no sysbuild, no MCUboot.

cmake_minimum_required(VERSION 3.20.0)

find_package(Zephyr REQUIRED HINTS $ENV{ZEPHYR_BASE})
project(quickstart_bluetooth)

target_sources(app PRIVATE src/main.c)

# Per-board app-identity UUID suffix (last 48 bits of BT_UUID_QSBT_ID_VAL), so
# the mobile app can tell boards apart without a hand-maintained table here.
string(SHA1 qsbt_board_hash "${CONFIG_BOARD}")
string(SUBSTRING "${qsbt_board_hash}" 0 12 qsbt_board_suffix)
target_compile_definitions(app PRIVATE QSBT_ID_BOARD_SUFFIX=0x${qsbt_board_suffix}ULL)

# Temporary workaround until this fix is upstreamed:
# https://github.com/memfault/memfault-firmware-sdk/pull/120
zephyr_compile_definitions(MEMFAULT_PROJECT_KEY_LEN=32)
```

## Kconfig
```
# Copyright (c) 2026 Nordic Semiconductor ASA
#
# SPDX-License-Identifier: LicenseRef-Nordic-5-Clause
#
# App-specific Kconfig. Intentionally thin — almost all configuration lives in
# prj.conf. Add app-local options here only if they emerge.

# Report $(APPVERSION) (e.g. 1.2.3 / 1.2.3-rc1) to Memfault, not the NCS default
# $(APP_VERSION_TWEAK_STRING) (1.2.3+0). Must be a Kconfig default to expand.
config MEMFAULT_NCS_FW_VERSION
	default "$(APPVERSION)"

# Per-board DIS Hardware Revision, so it stays correct on every supported board.
configdefault BT_DIS_HW_REV_STR
	default BOARD

config QSBT_DEFAULT_PROJECT_KEY
	string "Default Memfault project key baked in at build time"
	depends on MEMFAULT_PROJECT_KEY_SETTINGS
	help
	  Optional 32-char Memfault project key applied on first boot if no key
	  has been provisioned yet via the settings shell (`settings write
	  string memfault/project_key ...`). Intended to be set at build time
	  (e.g. `-DCONFIG_QSBT_DEFAULT_PROJECT_KEY="<key>"`) so release
	  artifacts work out of the box, while a key written later via the
	  shell still overrides it on the next boot. Left empty, the device
	  ships with no key until provisioned.

source "Kconfig.zephyr"
```

## Kconfig.sysbuild
```
#
# Copyright (c) 2026 Nordic Semiconductor
#
# SPDX-License-Identifier: LicenseRef-Nordic-5-Clause
#

# nRF54H20 is multi-core: the Bluetooth controller runs on the radio core
# (cpurad) and the app talks to it over HCI/IPC. Build the ipc_radio image for
# cpurad and load it from MRAM into TCM with the radio loader (no MCUboot, to
# match this app's single-image, bootloader-free model on the L-series boards).
config NRF_RADIO_LOADER
	default y if SOC_NRF54H20

config NRF_DEFAULT_IPC_RADIO
	default y

config NETCORE_IPC_RADIO_BT_HCI_IPC
	default y

source "share/sysbuild/Kconfig"
```

## prj.conf
```kconfig
# quickstart-bluetooth application configuration.
#
# peripheral_lbs base + Memfault observability over the MDS BLE gateway path.

# --- Base BLE + LBS ---------------------------------------------------------
CONFIG_BT=y
CONFIG_BT_PERIPHERAL=y
CONFIG_BT_SHELL=y
# Encryption/pairing/bonding disabled for this sample. MDS access is instead
# gated to the first connected gateway link (see mds_access_enable() in
# main.c). A real product handling sensitive data should set CONFIG_BT_SMP=y
# and use bonding (CONFIG_BT_BONDABLE=y, the default) instead.
CONFIG_BT_SMP=n
# BT_L2CAP_TX_MTU/BT_BUF_ACL_RX_SIZE default lower without CONFIG_BT_SMP=y
# (23/27 vs 65/69), which caps the negotiated ATT MTU. Set these explicitly to
# the max the nRF54L15's Data Length Extension supports (251-byte ACL/LL PDU,
# 247-byte L2CAP/ATT payload) regardless of the SMP setting, and have the
# device initiate the ATT MTU exchange itself on connect rather than relying
# on the central to do it.
CONFIG_BT_L2CAP_TX_MTU=247
CONFIG_BT_BUF_ACL_TX_SIZE=251
CONFIG_BT_BUF_ACL_RX_SIZE=251
CONFIG_BT_GATT_CLIENT=y
CONFIG_BT_GATT_AUTO_UPDATE_MTU=y
CONFIG_BT_DEVICE_NAME="Quickstart_Bluetooth"
# Allows a name provisioned over the `bt name <name>` shell command (settings
# key bt/name) to override the build-time default above, applied on the next
# boot — mirrors the runtime project key provisioning flow below.
CONFIG_BT_DEVICE_NAME_DYNAMIC=y
CONFIG_NCS_APPLICATION_BOOT_BANNER_STRING="Quickstart Bluetooth"
CONFIG_BT_LBS=y
CONFIG_BT_LBS_POLL_BUTTON=y
CONFIG_DK_LIBRARY=y

# --- MDS gateway path -------------------------------------------------------
# The device serves Memfault chunks to the gateway; no on-device HTTP/TLS.
CONFIG_BT_MDS=y
# Drain chunks ~1s for a snappy demo
CONFIG_BT_MDS_DATA_POLL_INTERVAL=1000

# --- Memfault core ----------------------------------------------------------
CONFIG_MEMFAULT=y
CONFIG_MEMFAULT_SHELL=y
# Without CONFIG_LOG, Memfault's log macros (used by e.g. `mflt get_device_info`,
# `mflt metrics_dump`) fall back to bare printk() (see
# MEMFAULT_PLATFORM_LOG_FALLBACK_TO_PRINTK), which is not coordinated with the
# interrupt-driven shell backend and gets silently dropped while a shell
# command is executing. Enabling LOG routes them through the log subsystem,
# which the shell backend explicitly multiplexes with the prompt.
CONFIG_LOG=y
CONFIG_MEMFAULT_NCS_FW_TYPE="main"
# Version derives from app/VERSION; do not hardcode it. app/Kconfig
# sets the reported version to $(APPVERSION) (e.g. 1.0.0 / 1.0.0-rc1).
CONFIG_MEMFAULT_NCS_FW_VERSION_STATIC=y
CONFIG_MEMFAULT_METRICS_HEARTBEAT_INTERVAL_SECS=60
CONFIG_MEMFAULT_EVENT_STORAGE_SIZE=4096
CONFIG_MEMFAULT_RAM_BACKED_COREDUMP=y
CONFIG_MEMFAULT_RAM_BACKED_COREDUMP_SIZE=8192

# --- Runtime project key -------------
# A key stored at the settings key `memfault/project_key` overrides the
# build-time default key (CONFIG_QSBT_DEFAULT_PROJECT_KEY, if any) and is
# applied on the next boot.
CONFIG_MEMFAULT_PROJECT_KEY_SETTINGS=y

# --- Settings storage + serial provisioning ---------------------------------
CONFIG_BT_SETTINGS=y
CONFIG_FLASH=y
CONFIG_FLASH_MAP=y
CONFIG_SETTINGS=y
CONFIG_ZMS=y
# Provides `settings write/read/delete`
CONFIG_SETTINGS_SHELL=y
CONFIG_SHELL=y
# `kernel reboot cold` after provisioning
CONFIG_REBOOT=y
CONFIG_KERNEL_SHELL=y

# --- Unique device ID from FICR via hw_id (discoverable with nrfutil) -------
CONFIG_MEMFAULT_NCS_DEVICE_ID_HW_ID=y
CONFIG_HW_ID_LIBRARY_SOURCE_DEVICE_ID=y

# --- Device Information Service (metadata) ----------------------------------
CONFIG_BT_DIS=y
CONFIG_BT_DIS_MANUF_NAME_STR="Nordic Semiconductor"
# Hardware Revision instead of Model Number; Firmware Revision tracks app/VERSION.
CONFIG_BT_DIS_MODEL_NUMBER=n
CONFIG_BT_DIS_HW_REV=y
CONFIG_BT_DIS_FW_REV=y
# PnP_ID defaulted to an unrelated vendor (Ericsson) - not applicable here.
CONFIG_BT_DIS_PNP=n
```

## boards/nrf54h20dk_nrf54h20_cpuapp.conf
```kconfig
#
# Copyright (c) 2026 Nordic Semiconductor ASA
#
# SPDX-License-Identifier: LicenseRef-Nordic-5-Clause
#

# Hardware Revision reported over the BLE Device Information Service.
CONFIG_BT_DIS_HW_REV_STR="nrf54h20"

# Enable the radio core so sysbuild builds and flashes the ipc_radio image
# that provides the Bluetooth controller over HCI/IPC.
CONFIG_SOC_NRF54H20_CPURAD_ENABLE=y

# Power management (mirrors the peripheral_lbs sample defaults for this board).
CONFIG_PM_DEVICE=y
CONFIG_PM_DEVICE_RUNTIME=y
CONFIG_PM=y
CONFIG_POWEROFF=y

# MRAM latency optimization - allow MRAM to power off when idle.
CONFIG_MRAM_LATENCY_AUTO_REQ=n

# Peak Current Management.
CONFIG_MPSL_FORCE_RRAM_ON_ALL_THE_TIME=n
```

## boards/nrf54l15dk_nrf54l15_cpuapp.conf
```kconfig
# Board-specific overrides for the nRF54L15 DK.

# Hardware Revision reported over the BLE Device Information Service.
CONFIG_BT_DIS_HW_REV_STR="nrf54l15"
```

## boards/nrf54lm20dk_nrf54lm20a_cpuapp.conf
```kconfig
# Board-specific overrides for the nRF54LM20 DK.

# Hardware Revision reported over the BLE Device Information Service.
CONFIG_BT_DIS_HW_REV_STR="nrf54lm20"
```

## src/main.c
```c
/*
 * Copyright (c) 2026 Nordic Semiconductor ASA
 *
 * SPDX-License-Identifier: LicenseRef-Nordic-5-Clause
 */

/*
 * quickstart-bluetooth application.
 *
 * The peripheral_lbs button/LED base with Memfault observability over the
 * Memfault Diagnostic Service (MDS). The device serves Memfault chunks to the
 * first connected gateway; the gateway performs the HTTPS upload. The device
 * never does on-device HTTP/TLS. No pairing/encryption (CONFIG_BT_SMP=n). A
 * real product handling sensitive data should enable BT_SMP and bonding.
 *
 * Controls (nRF54L15 DK):
 *   Button 0  LBS button characteristic (standard LBS — central sees the press)
 *   Button 1  DEMO-ONLY crash trigger (forces a fault -> Memfault coredump)
 *   LED 0     run status (1 Hz heartbeat blink)
 *   LED 1     BLE connection status
 *   LED 2     LBS LED (controlled by the central/gateway — standard LBS)
 */

#include <string.h>

#include <zephyr/kernel.h>
#include <zephyr/types.h>

#include <zephyr/bluetooth/bluetooth.h>
#include <zephyr/bluetooth/conn.h>
#include <zephyr/bluetooth/gatt.h>
#include <zephyr/bluetooth/hci.h>
#include <zephyr/bluetooth/uuid.h>

#include <bluetooth/services/lbs.h>
#include <bluetooth/services/mds.h>

#include <zephyr/settings/settings.h>

#include <dk_buttons_and_leds.h>

#include <memfault/metrics/metrics.h>
#include <memfault/ports/zephyr/http.h>

#define RUN_STATUS_LED         DK_LED1
#define CON_STATUS_LED         DK_LED2
#define LBS_LED                DK_LED3
#define RUN_LED_BLINK_INTERVAL 1000

#define LBS_BUTTON   DK_BTN1_MSK
#define CRASH_BUTTON DK_BTN2_MSK /* DEMO-ONLY, see button_handler() */

/* App-identity marker: an empty vendor service whose UUID the nRF Toolbox app
 * discovers over GATT to recognize this firmware and tailor its UX. The prefix
 * is fixed; the last 48 bits are SHA1(CONFIG_BOARD), set in CMakeLists.txt, so
 * each board gets a distinct UUID.
 */
#define BT_UUID_QSBT_ID_VAL                                                                        \
	BT_UUID_128_ENCODE(0xb2007aaa, 0xc203, 0x43a5, 0x8b6f, QSBT_ID_BOARD_SUFFIX)
#define BT_UUID_QSBT_ID     BT_UUID_DECLARE_128(BT_UUID_QSBT_ID_VAL)

/* Named to sort alphabetically before lbs_svc/mds_svc: Zephyr's
 * BT_GATT_SERVICE_DEFINE places services into a linker section sorted by name
 * (SORT_BY_NAME), so this controls GATT discovery order, not declaration
 * order. Mobile app requests: custom, lbs, MDS.
 */
BT_GATT_SERVICE_DEFINE(custom_id_svc, BT_GATT_PRIMARY_SERVICE(BT_UUID_QSBT_ID));

static bool app_button_state;
static struct bt_conn *mds_conn;
static struct k_work adv_work;

static const struct bt_data sd[] = {
	BT_DATA_BYTES(BT_DATA_UUID128_ALL, BT_UUID_QSBT_ID_VAL),
};

static void adv_work_handler(struct k_work *work)
{
	/* Read the name fresh on every (re)start so a name provisioned over the
	 * `bt name` shell command (settings key bt/name, applied on the next
	 * boot — see CONFIG_BT_DEVICE_NAME_DYNAMIC) is reflected in the
	 * advertising data.
	 */
	const char *name = bt_get_name();
	/* Advertise the app-identity UUID (not the LBS UUID) so the mobile app
	 * can recognize this as a quickstart device from the scan list, before
	 * connecting. MDS is discovered over GATT after connecting; it does not
	 * need to be advertised.
	 */
	const struct bt_data ad[] = {
		BT_DATA_BYTES(BT_DATA_FLAGS, (BT_LE_AD_GENERAL | BT_LE_AD_NO_BREDR)),
		BT_DATA(BT_DATA_NAME_COMPLETE, name, strlen(name)),
	};
	int err = bt_le_adv_start(BT_LE_ADV_CONN_FAST_2, ad, ARRAY_SIZE(ad), sd, ARRAY_SIZE(sd));

	if (err) {
		printk("Advertising failed to start (err %d)\n", err);
		return;
	}

	printk("Advertising successfully started\n");
}

static void advertising_start(void)
{
	k_work_submit(&adv_work);
}

static void connected(struct bt_conn *conn, uint8_t err)
{
	if (err) {
		printk("Connection failed, err 0x%02x %s\n", err, bt_hci_err_to_str(err));
		return;
	}

	printk("Connected\n");
	dk_set_led_on(CON_STATUS_LED);

	/* No pairing/encryption in this sample (CONFIG_BT_SMP=n). The first
	 * connected central is treated as the MDS-authorized gateway. Capture a
	 * heartbeat immediately so the device (with its software/hardware
	 * version and serial) appears in Memfault within seconds instead of
	 * waiting for the periodic heartbeat timer.
	 */
	if (!mds_conn) {
		mds_conn = conn;
		memfault_metrics_heartbeat_debug_trigger();
	}
}

static void disconnected(struct bt_conn *conn, uint8_t reason)
{
	printk("Disconnected, reason 0x%02x %s\n", reason, bt_hci_err_to_str(reason));

	dk_set_led_off(CON_STATUS_LED);

	if (conn == mds_conn) {
		mds_conn = NULL;
	}
}

static void recycled_cb(void)
{
	advertising_start();
}

BT_CONN_CB_DEFINE(conn_callbacks) = {
	.connected = connected,
	.disconnected = disconnected,
	.recycled = recycled_cb,
};

/* Gate MDS access to the first connected gateway link only. */
static bool mds_access_enable(struct bt_conn *conn)
{
	return (mds_conn && conn == mds_conn);
}

static const struct bt_mds_cb mds_cb = {
	.access_enable = mds_access_enable,
};

/* Standard LBS callbacks: central writes the LED, reads the button state. */
static void app_led_cb(bool led_state)
{
	dk_set_led(LBS_LED, led_state);
}

static bool app_button_cb(void)
{
	return app_button_state;
}

static struct bt_lbs_cb lbs_callbacks = {
	.led_cb = app_led_cb,
	.button_cb = app_button_cb,
};

static void button_handler(uint32_t button_state, uint32_t has_changed)
{
	if (has_changed & LBS_BUTTON) {
		uint32_t pressed = button_state & LBS_BUTTON;

		bt_lbs_send_button_state(pressed);
		app_button_state = pressed ? true : false;
	}

	/* DEMO-ONLY: force a fault so the guide can show a coredump in Memfault.
	 * Remove this in a real product — a button should never crash firmware.
	 */
	if ((button_state & has_changed) & CRASH_BUTTON) {
		printk("Crash button pressed — forcing a fault for the Memfault demo\n");
		k_oops();
	}
}

int main(void)
{
	uint32_t blink_status = 0;
	int err;

	printk("Starting quickstart-bluetooth (LBS + Memfault/MDS)\n");

	err = dk_leds_init();
	if (err) {
		printk("LEDs init failed (err %d)\n", err);
		return 0;
	}

	err = dk_buttons_init(button_handler);
	if (err) {
		printk("Buttons init failed (err %d)\n", err);
		return 0;
	}

	/* Register before bt_enable() so MDS access gating is in place from the
	 * first connection (see bt_mds_cb_register() docs).
	 */
	err = bt_mds_cb_register(&mds_cb);
	if (err) {
		printk("MDS callback registration failed (err %d)\n", err);
		return 0;
	}

	err = bt_enable(NULL);
	if (err) {
		printk("Bluetooth init failed (err %d)\n", err);
		return 0;
	}

	printk("Bluetooth initialized\n");

#if defined(CONFIG_SETTINGS)
	/* Loads the stored Memfault project key (memfault/project_key). The
	 * runtime key is applied here at boot, not live.
	 */
	settings_load();

#if defined(CONFIG_MEMFAULT_PROJECT_KEY_SETTINGS)
	/* No key provisioned yet: fall back to the build-time default (if any),
	 * baked in via CONFIG_QSBT_DEFAULT_PROJECT_KEY. A key written later via
	 * the settings shell overrides this on the next boot.
	 */
	if (sizeof(CONFIG_QSBT_DEFAULT_PROJECT_KEY) > 1
	    && settings_get_val_len("memfault/project_key") <= 0) {
		err = memfault_zephyr_port_set_project_key(CONFIG_QSBT_DEFAULT_PROJECT_KEY,
							   sizeof(CONFIG_QSBT_DEFAULT_PROJECT_KEY)
								   - 1);
		if (err) {
			printk("Failed to set default Memfault project key (err %d)\n", err);
		}
	}
#endif /* CONFIG_MEMFAULT_PROJECT_KEY_SETTINGS */
#endif /* CONFIG_SETTINGS */

	err = bt_lbs_init(&lbs_callbacks);
	if (err) {
		printk("Failed to init LBS (err %d)\n", err);
		return 0;
	}

	k_work_init(&adv_work, adv_work_handler);
	advertising_start();

	for (;;) {
		dk_set_led(RUN_STATUS_LED, (++blink_status) % 2);
		k_sleep(K_MSEC(RUN_LED_BLINK_INTERVAL));
	}
}
```
