## west.yml
```yaml
# Copyright (c) 2026 Nordic Semiconductor
# SPDX-License-Identifier: LicenseRef-Nordic-5-Clause

manifest:
  remotes:
    - name: ncs
      url-base: https://github.com/nrfconnect

  projects:
    - name: sdk-nrf
      remote: ncs
      repo-path: sdk-nrf
      path: nrf
      revision: 40e850a75071f913bc54147a70aad165b2ca184a
      west-commands: scripts/west-commands.yml
      import:
        # Exclude some known-unused and large modules
        name-blocklist:
          - lvgl
          - matter

  self:
    path: project
```
